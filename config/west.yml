## config/west.yml
```yaml
manifest:
  defaults:
    revision: v0.3
  remotes:
    - name: zmkfirmware
      url-base: https://github.com/zmkfirmware
    - name: carrefinho                            # <---
      url-base: https://github.com/carrefinho     # <---
    - name: caksoylar                             # <---
      url-base: https://github.com/caksoylar      # <---
    - name: englmaxi                              # <---
      url-base: https://github.com/englmaxi       # <---
    - name: H0N3YC4T                              # <---
      url-base: https://github.com/H0N3YC4T       # <---
  projects:
    - name: zmk
      remote: H0N3YC4T
      revision: 9a4ae7b9220c225f6b5ed891be45fb8dcb583e11
      import: app/west.yml
    - name: forager-zmk-module                    # <---
      remote: carrefinho                          # <---
      revision: 3cafe6b7b26d7b538949e138fc00a148def4b2ed # <---
    - name: zmk-rgbled-widget                     # <---
      remote: caksoylar                           # <---
      revision: e6b467792a1dabef8cfa5c9fd26bfefc9c16662b # <---
    - name: zmk-dongle-display                    # <---
      remote: englmaxi                            # <---
      revision: 2bb333f87136d33e94a49d86236ed9ec254a8060 # <---
  self:
    path: config
```
